//Si Pham (tonka7su)
//October 23, 2021
//Steve

#include <Arduboy2.h>

#define GROUND_LEVEL        55
#define STEVE_GROUND_LEVEL  GROUND_LEVEL + 7
#define SPEED               2

/* **********************************************************
    CONSTANTS    
  ********************************************************** 
  */

const uint8_t PROGMEM dinosaur_still[] = {
  18, 21,
  0x00, 0x00, 0x00, 0x00, 0x00, 0x00, 0x00, 0x00, 0x00, 0xFE, 0xFF, 0xFB, 0xFF, 0xFF, 0xBF, 0xBF, 0x3F, 0x3E,
  0x3F, 0x7C, 0xF8, 0xF0, 0xF0, 0xF8, 0xFC, 0xFE, 0xFF, 0xFF, 0xFF, 0x7F, 0x3F, 0x04, 0x0C, 0x00, 0x00, 0x00,
  0x00, 0x00, 0x00, 0x01, 0x1F, 0x17, 0x03, 0x01, 0x03, 0x1F, 0x10, 0x00, 0x00, 0x00, 0x00, 0x00, 0x00, 0x00,
};

const uint8_t PROGMEM dinosaur_running_1[] = {
  18, 21,
  0x00, 0x00, 0x00, 0x00, 0x00, 0x00, 0x00, 0x00, 0x00, 0xFE, 0xFF, 0xFB, 0xFF, 0xFF, 0xBF, 0xBF, 0x3F, 0x3E,
  0x3F, 0x7C, 0xF8, 0xF0, 0xF0, 0xF8, 0xFC, 0xFE, 0xFF, 0xFF, 0xFF, 0x7F, 0x3F, 0x04, 0x0C, 0x00, 0x00, 0x00,
  0x00, 0x00, 0x00, 0x01, 0x0F, 0x0B, 0x01, 0x01, 0x03, 0x1F, 0x10, 0x00, 0x00, 0x00, 0x00, 0x00, 0x00, 0x00,
};

const uint8_t PROGMEM dinosaur_running_2[] = {
  18, 21,
  0x00, 0x00, 0x00, 0x00, 0x00, 0x00, 0x00, 0x00, 0x00, 0xFE, 0xFF, 0xFB, 0xFF, 0xFF, 0xBF, 0xBF, 0x3F, 0x3E,
  0x3F, 0x7C, 0xF8, 0xF0, 0xF0, 0xF8, 0xFC, 0xFE, 0xFF, 0xFF, 0xFF, 0x7F, 0x3F, 0x04, 0x0C, 0x00, 0x00, 0x00,
  0x00, 0x00, 0x00, 0x01, 0x1F, 0x17, 0x03, 0x01, 0x03, 0x0F, 0x08, 0x00, 0x00, 0x00, 0x00, 0x00, 0x00, 0x00,
};

const uint8_t PROGMEM dinosaur_ducking_1[] = {
  26, 13,
  0x07, 0x0E, 0x1E, 0x3C, 0x7C, 0xFC, 0xFC, 0xFE, 0xFE, 0xFE, 0xFE, 0xFE, 0xFE, 0xFE, 0xFC, 0x7C, 0x7C, 0xFE, 0xFF, 0xFB, 0xFF, 0xFF, 0xBF, 0xBF, 0x3F, 0x3E,
  0x00, 0x00, 0x00, 0x00, 0x00, 0x06, 0x05, 0x01, 0x1F, 0x17, 0x03, 0x01, 0x00, 0x03, 0x02, 0x00, 0x00, 0x00, 0x00, 0x00, 0x00, 0x00, 0x00, 0x00, 0x00, 0x00,
};

const uint8_t PROGMEM dinosaur_ducking_2[] = {
  26, 13,
  0x07, 0x0E, 0x1E, 0x3C, 0x7C, 0xFC, 0xFC, 0xFE, 0xFE, 0xFE, 0xFE, 0xFE, 0xFE, 0xFE, 0xFC, 0x7C, 0x7C, 0xFE, 0xFF, 0xFB, 0xFF, 0xFF, 0xBF, 0xBF, 0x3F, 0x3E,
  0x00, 0x00, 0x00, 0x00, 0x00, 0x1E, 0x17, 0x03, 0x01, 0x01, 0x07, 0x05, 0x00, 0x03, 0x02, 0x00, 0x00, 0x00, 0x00, 0x00, 0x00, 0x00, 0x00, 0x00, 0x00, 0x00,
};

const uint8_t PROGMEM dinosaur_still_mask[] = {
  0x00,	0x00,	0x00,	0x00,	0x00,	0x00,	0x00,	0x00,	0x00,	0xFE,	0xFF,	0xFF,	0xFF,	0xFF,	0xBF,	0xBF,	0x3F,	0x3E,
  0x3F,	0x7C,	0xF8,	0xF0,	0xF0,	0xF8,	0xFC,	0xFE,	0xFF,	0xFF,	0xFF,	0x7F,	0x3F,	0x04,	0x0C,	0x00,	0x00,	0x00,
  0x00,	0x00,	0x01,	0x3F,	0x3F,	0x3F,	0x3F,	0x03,	0x3F,	0x3F,	0x3F,	0x38,	0x00,	0x00,	0x00,	0x00,	0x00,	0x00,
};

const uint8_t PROGMEM dinosaur_running_1_mask[] = {
  0x00,	0x00,	0x00,	0x00,	0x00,	0x00,	0x00,	0x00,	0x00,	0xFE,	0xFF,	0xFF,	0xFF,	0xFF,	0xBF,	0xBF,	0x3F,	0x3E,
  0x3F,	0x7C,	0xF8,	0xF0,	0xF0,	0xF8,	0xFC,	0xFE,	0xFF,	0xFF,	0xFF,	0x7F,	0x3F,	0x04,	0x0C,	0x00,	0x00,	0x00,
  0x00,	0x00,	0x01,	0x1F,	0x1F,	0x1F,	0x1F,	0x03,	0x3F,	0x3F,	0x3F,	0x38,	0x00,	0x00,	0x00,	0x00,	0x00,	0x00,
};

const uint8_t PROGMEM dinosaur_running_2_mask[] = {
  0x00,	0x00,	0x00,	0x00,	0x00,	0x00,	0x00,	0x00,	0x00,	0xFE,	0xFF,	0xFF,	0xFF,	0xFF,	0xBF,	0xBF,	0x3F,	0x3E,
  0x3F,	0x7C,	0xF8,	0xF0,	0xF0,	0xF8,	0xFC,	0xFE,	0xFF,	0xFF,	0xFF,	0x7F,	0x3F,	0x04,	0x0C,	0x00,	0x00,	0x00,
  0x00,	0x00,	0x01,	0x3F,	0x3F,	0x3F,	0x3F,	0x03,	0x1F,	0x1F,	0x1F,	0x1C,	0x00,	0x00,	0x00,	0x00,	0x00,	0x00,
};

const uint8_t PROGMEM dinosaur_ducking_1_mask[] = {
  0x07,	0x0E,	0x1E,	0x3C,	0x7C,	0xFC,	0xFC,	0xFE,	0xFE,	0xFE,	0xFE,	0xFE,	0xFE,	0xFE,	0xFC,	0x7C,	0x7C,	0xFE,	0xFF,	0xFF,	0xFF,	0xFF,	0xBF,	0xBF,	0x3F,	0x3E,
  0x00,	0x00,	0x00,	0x00,	0x0F,	0x0F,	0x0F,	0x3F,	0x3F,	0x3F,	0x3F,	0x03,	0x07,	0x07,	0x07,	0x07,	0x01,	0x01,	0x01,	0x01,	0x01,	0x01,	0x01,	0x01,	0x00,	0x00,};

const uint8_t PROGMEM dinosaur_ducking_2_mask[] = {
  0x07,	0x0E,	0x1E,	0x3C,	0x7C,	0xFC,	0xFC,	0xFE,	0xFE,	0xFE,	0xFE,	0xFE,	0xFE,	0xFE,	0xFC,	0x7C,	0x7C,	0xFE,	0xFF,	0xFF,	0xFF,	0xFF,	0xBF,	0xBF,	0x3F,	0x3E,
  0x00,	0x00,	0x00,	0x00,	0x3F,	0x3F,	0x3F,	0x3F,	0x03,	0x0F,	0x0F,	0x0F,	0x0F,	0x07,	0x07,	0x07,	0x01,	0x01,	0x01,	0x01,	0x01,	0x01,	0x01,	0x01,	0x00,	0x00,
};

const uint8_t PROGMEM dinosaur_dead_1[] = {
  18, 21,
  0x00, 0x00, 0x00, 0x00, 0x00, 0x00, 0x00, 0x00, 0x00, 0xFE, 0xFF, 0xE3, 0xEB, 0xE3, 0xBF, 0xBF, 0x3F, 0x3E,
  0x3F, 0x7C, 0xF8, 0xF0, 0xF0, 0xF8, 0xFC, 0xFE, 0xFF, 0xFF, 0xFF, 0x7F, 0x3F, 0x04, 0x0C, 0x00, 0x00, 0x00,
  0x00, 0x00, 0x00, 0x01, 0x1F, 0x17, 0x03, 0x01, 0x03, 0x1F, 0x10, 0x00, 0x00, 0x00, 0x00, 0x00, 0x00, 0x00,
};

const uint8_t PROGMEM dinosaur_dead_2[] = {
  26, 13,
  0x70,	0xE0,	0xE0,	0xC0,	0xC0,	0xC0,	0xC0,	0xE0,	0xE0,	0xE0,	0xE0,	0xE0,	0xE0,	0xE0,	0xC0,	0xC0,	0x80,	0xC0,	0xE0,	0x60,	0xE0,	0x60,	0xE0,	0xE0,	0xE0,	0xC0,
  0x00,	0x00,	0x01,	0x13,	0x17,	0x0F,	0x1F,	0x1F,	0x1F,	0x1F,	0x1F,	0x1F,	0x0F,	0x1F,	0x0F,	0x07,	0x0F,	0x1F,	0x1F,	0x1D,	0x1E,	0x1D,	0x17,	0x17,	0x07,	0x07,
};

const uint8_t PROGMEM dinosaur_dead_2_mask[] = {
  0x70,	0xE0,	0xE0,	0xC0,	0xC0,	0xC0,	0xC0,	0xE0,	0xE0,	0xE0,	0xE0,	0xE0,	0xE0,	0xE0,	0xC0,	0xC0,	0x80,	0xC0,	0xE0,	0xE0,	0xE0,	0xE0,	0xE0,	0xE0,	0xE0,	0xC0,
  0x00,	0x01,	0x3B,	0x3F,	0x3F,	0x1F,	0x3F,	0x3F,	0x3F,	0x3F,	0x3F,	0x3F,	0x1F,	0x3F,	0x1F,	0x0F,	0x1F,	0x3F,	0x3F,	0x3F,	0x3F,	0x3F,	0x3F,	0x3F,	0x0F,	0x0F,
};

const byte PROGMEM ground_flat[] = {
  32, 8,
  0x14,	0x04,	0x04,	0x24,	0x04,	0x44,	0x44,	0x04,	0x04,	0x04,	0x04,	0x04,	0x24,	0x04,	0x04,	0x04,	0x04,	0x14,	0x14,	0x04,	0x04,	0x04,	0x44,	0x44,	0x04,	0x04,	0x04,	0x04,	0x24,	0x04,	0x04,	0x04,
};

const byte PROGMEM ground_bump[] = {
  32, 8,
  0x04, 0x24, 0x24, 0x04, 0x04, 0x04, 0x44, 0x04, 0x04, 0x04, 0x14, 0x04, 0x22, 0x02, 0x01, 0x01, 0x09, 0x81, 0x82, 0x02, 0x04, 0x04, 0x04, 0x14, 0x04, 0x04, 0x04, 0x44, 0x44, 0x04, 0x04, 0x04,
};

const byte PROGMEM ground_hole[] = {
  32, 8,
  0x84, 0x84, 0x04, 0x04, 0x04, 0x14, 0x04, 0x14, 0x04, 0x44, 0x04, 0x04, 0x08, 0x08, 0x90, 0x90, 0x10, 0x10, 0x10, 0x08, 0x08, 0x04, 0x44, 0x44, 0x04, 0x04, 0x04, 0x14, 0x04, 0x24, 0x04, 0x04,
};

enum class GroundType : uint8_t {
  Flat,
  Bump,
  Hole,
};

const byte *ground_images[] = { ground_flat, ground_bump, ground_hole };

enum class Stance : uint8_t {
  Standing,
  Running1,
  Running2,
  Ducking1,
  Ducking2,
  Dead1,
  Dead2,
};

const uint8_t *steve_images[] = {
  dinosaur_still,
  dinosaur_running_1,
  dinosaur_running_2,
  dinosaur_ducking_1,
  dinosaur_ducking_2,
  dinosaur_dead_1,
  dinosaur_dead_2,
};

const uint8_t *steve_masks[] = {
  dinosaur_still_mask,
  dinosaur_running_1_mask,
  dinosaur_running_2_mask,
  dinosaur_ducking_1_mask,
  dinosaur_ducking_2_mask,
  // dinosaur_dead_1_mask,
  dinosaur_dead_2_mask,
};

const uint8_t jumpCoords[] = {55, 52, 47, 43, 40, 38, 36, 34, 33, 31, 30, 29, 28,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 51, 55 };

struct Steve
{
  uint8_t x;
  uint8_t y;
  Stance stance;
  bool jumping;
  uint8_t jumpIndex;
  const uint8_t *image;
  const uint8_t *mask;
};

/* **********************************************************
    VARS    
  ********************************************************** 
  */

Arduboy2 arduboy;
int groundX = 0;

GroundType ground[5] = {
  GroundType::Flat,
  GroundType::Flat,
  GroundType::Hole,
  GroundType::Flat,
  GroundType::Flat,
};

Steve steve = {
  0,
  STEVE_GROUND_LEVEL,
  Stance::Standing,
  false,
  false,
  dinosaur_still,
  dinosaur_still_mask
};

/* **********************************************************
    FUNCTIONS    
  ********************************************************** 
  */
uint8_t getImageWidth(const uint8_t *image) {
  return pgm_read_byte(image);
}

uint8_t getImageHeight(const uint8_t *image) {
  return pgm_read_byte(image + 1);
}

void setup() {
  arduboy.begin();
  arduboy.setFrameRate(75);
  arduboy.display();
  // arduboy.initRandomSeed();
  arduboy.clear();
}

void moveLeft() {
  groundX -= SPEED;
}

void moveRight() {
  groundX += SPEED;
}

void playerInput() {
  if (arduboy.pressed(LEFT_BUTTON)) {
    moveLeft();
  }
  if (arduboy.pressed(RIGHT_BUTTON)) {
    moveRight();
  }
}

void drawGround() {
  // calculate the next ground tile
  if (groundX % 32 == 0)
  {
    groundX = 0;

    uint8_t type = random(0, 6);
    GroundType groundType;

    switch (type)
    {
    case 0 ... 3:
      groundType = GroundType::Flat;
      break;

    case 4:
      groundType = GroundType::Bump;
      break;

    case 5:
      groundType = GroundType::Hole;
      break;
    
    default:
      break;
    }

    ground[0] = ground[1];
    ground[1] = ground[2];
    ground[2] = ground[3];
    ground[3] = ground[4];
    ground[5] = groundType;
  }

  groundX++;
  
  // draw scrolling ground
  for (uint8_t i = 0; i < 5; i++) {
    uint8_t imageIndex = static_cast<uint8_t>(ground[i]);
    Sprites::drawSelfMasked((i * 32) - groundX, GROUND_LEVEL, ground_images[imageIndex], 0);
  }
}

void updateSteve() {
  if (steve.jumping) {
    steve.y = jumpCoords[steve.jumpIndex];
    steve.jumpIndex++;

    if (steve.jumpIndex == sizeof(jumpCoords)) {
      steve.jumping = false;
      steve.jumpIndex = 0;
      steve.y = STEVE_GROUND_LEVEL;
    }
  }
  else {
    // running
    if (arduboy.everyXFrames(9)) {
      switch (steve.stance)
      {
      case Stance::Running1:
        steve.stance = Stance::Running2;
        break;

      case Stance::Running2:
        steve.stance = Stance::Running1;
        break;
      
      case Stance::Ducking1:
        steve.stance = Stance::Ducking2;
        break;

      case Stance::Ducking2:
        steve.stance = Stance::Ducking1;
        break;

      case Stance::Dead1:
        steve.stance = Stance::Dead2;
        break;

      default:
        break;
      }
    }
  }
}

void drawSteve() {
  uint8_t imageIndex = static_cast<uint8_t>(steve.stance);

  steve.image = steve_images[imageIndex];
  steve.mask = steve_masks[imageIndex];
  // draw steve
  // Sprites::drawOverwrite(3, 4, dinosaur_still, 0);
  Sprites::drawExternalMask(steve.x, steve.y - getImageHeight(steve.image), steve.image, steve.mask, 0, 0);
}

void loop() {
  if (!arduboy.nextFrame()) {
    return;
  }
  arduboy.pollButtons();
  arduboy.clear();
  // arduboy.setCursor(0, 0);
  playerInput();
  if (!steve.jumping) {
    if (arduboy.justPressed(A_BUTTON)) {
      steve.jumping = true;
      steve.jumpIndex = 0;
    }

    if (arduboy.justPressed(B_BUTTON)) {
      if (steve.stance != Stance::Ducking2) {
        steve.stance = Stance::Ducking1;
      }
    }

    if (arduboy.pressed(LEFT_BUTTON) && steve.x > 0) {
      steve.x--;
    }

    if (arduboy.pressed(RIGHT_BUTTON) && steve.x < 100) {
      steve.x++;
    }

    if (arduboy.notPressed(B_BUTTON) &&
        (steve.stance == Stance::Ducking1 || steve.stance == Stance::Ducking2)) {
          steve.stance = Stance::Running1;
        }
  }
  updateSteve();
  drawGround();
  drawSteve();
  arduboy.display();
}
